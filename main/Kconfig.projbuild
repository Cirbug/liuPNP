## main/Kconfig.projbuild
```kconfig
menu "AI-PNP Configuration"

    config WIFI_SSID
        string "WiFi SSID"
        default "YOUR_WIFI_SSID"
        help
            WiFi network name for the ESP32-P4 to connect to.

    config WIFI_PASSWORD
        string "WiFi Password"
        default "YOUR_WIFI_PASSWORD"
        help
            WiFi password.

    config DOUBAO_API_KEY
        string "Doubao API Key"
        default "YOUR_DOUBAO_API_KEY"
        help
            API key for Doubao Vision API.
            Obtain from: https://console.volcengine.com/ark

    config DOUBAO_API_URL
        string "Doubao API URL"
        default "https://ark.cn-beijing.volces.com/api/v3"
        help
            Doubao Vision API base URL (without /chat/completions).

    config DOUBAO_MODEL
        string "Doubao Model"
        default "doubao-seed-1-6-vision-250815"
        help
            Doubao vision model name.

    config DOUBAO_TIMEOUT_MS
        int "Doubao API Timeout (ms)"
        default 15000
        help
            HTTP timeout for vision API calls.

    config DOUBAO_MAX_RETRIES
        int "Doubao API Max Retries"
        default 2
        range 0 5
        help
            Max retry times on API failure (0 = no retry).

    config HTTP_IMG_URL
        string "PC mjpg-streamer Snapshot URL"
        default "http://192.168.1.100:8080/?action=snapshot"
        help
            HTTP URL to fetch JPEG snapshots from mjpg-streamer.

endmenu
```

## sdkconfig.defaults
```kconfig
# ESP32-P4 MIPI CSI Camera + WiFi
CONFIG_IDF_TARGET="esp32p4"
CONFIG_ESPTOOLPY_FLASHSIZE_32MB=y
CONFIG_ESP32P4_SPIRAM_SUPPORT=y
CONFIG_SPIRAM=y
CONFIG_SPIRAM_MODE_OCT=y
CONFIG_SPIRAM_SPEED_80M=y
CONFIG_ESP_WIFI_STA=y
CONFIG_ESP_WIFI_SSID="YOUR_WIFI_SSID"
CONFIG_ESP_WIFI_PASSWORD="YOUR_WIFI_PASSWORD"
CONFIG_ESP_MAXIMUM_RETRY=5
CONFIG_CAMERA_OV5647=y
CONFIG_CAMERA_OV5640=y
# FATFS for TF卡
CONFIG_FATFS_LFN_HEAP=y
```

## sdkconfig.defaults.esp32p4
```kconfig
# ================================================================
# AI-PNP ESP32-P4 默认配置
# ================================================================

# ---- 板载 LED ----
CONFIG_BLINK_LED_STRIP=y
CONFIG_BLINK_GPIO=44

# ---- WiFi (使用前修改 SSID/PASSWORD) ----
CONFIG_WIFI_SSID="YOUR_WIFI_SSID"
CONFIG_WIFI_PASSWORD="YOUR_WIFI_PASSWORD"

# ---- PSRAM (摄像头缓冲必需) ----
CONFIG_SPIRAM=y
CONFIG_SPIRAM_USE_CAPS_ALLOC=y
CONFIG_SPIRAM_ALLOW_BSS_SEG_EXTERNAL_MEMORY=y

# ---- 摄像头 (esp_camera 组件) ----
CONFIG_CAMERA_ENABLE=y
CONFIG_CAMERA_MODEL_ESP32P4=y
CONFIG_CAMERA_PIN_XCLK=15
CONFIG_CAMERA_PIN_SIOD=10
CONFIG_CAMERA_PIN_SIOC=11
CONFIG_CAMERA_PIN_PWDN=-1
CONFIG_CAMERA_PIN_RESET=-1

# ---- FATFS (TF 卡读取 CSV) ----
CONFIG_FATFS_LFN_HEAP=y
CONFIG_FATFS_MAX_LFN=128
```
